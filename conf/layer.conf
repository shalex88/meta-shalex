## conf/layer.conf
```bitbake
# We have a conf and classes directory, add to BBPATH
BBPATH .= ":${LAYERDIR}"

# We have recipes-* directories, add to BBFILES
BBFILES += "${LAYERDIR}/recipes-*/*/*.bb \
            ${LAYERDIR}/recipes-*/*/*.bbappend"

BBFILE_COLLECTIONS += "shalex"
BBFILE_PATTERN_shalex = "^${LAYERDIR}/"
BBFILE_PRIORITY_shalex = "6"

LAYERDEPENDS_shalex = "core"
LAYERSERIES_COMPAT_shalex = "kirkstone"
```
